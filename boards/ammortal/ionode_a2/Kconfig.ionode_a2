## boards/ammortal/ionode_a2/Kconfig.ionode_a2
```kconfig
#
# Copyright 2024 NXP
#
# SPDX-License-Identifier: Apache-2.0

config BOARD_IONODE_A2
	select SOC_PART_NUMBER_MIMXRT1176DVMAA
	select SOC_MIMXRT1176_CM7 if BOARD_IONODE_A2_MIMXRT1176_CM7
	select SOC_MIMXRT1176_CM4 if BOARD_IONODE_A2_MIMXRT1176_CM4
```

## boards/ammortal/ionode_a2/board.yml
```yaml
board:
  name: ionode_a2
  full_name: IONODE-A2
  vendor: ammortal
  socs:
    - name: mimxrt1176
  revision:
    format: "letter"
    default: "A"
    revisions:
      - name: "A"
```

## boards/omnitek/rollwinder_rt1024/Kconfig.rollwinder_rt1024
```kconfig
# Copyright (c) 2020, NXP
# SPDX-License-Identifier: Apache-2.0

config BOARD_ROLLWINDER_RT1024
	select SOC_PART_NUMBER_MIMXRT1024DAG5A
```

## boards/omnitek/rollwinder_rt1024/board.yml
```yaml
board:
  name: rollwinder_rt1024
  full_name: Rollwinder RT1024 Motor Control Board
  vendor: omnitek
  socs:
    - name: mimxrt1024
```

## ionode-test/build/Kconfig/arch/Kconfig
```kconfig
# Load Zephyr Arch Kconfig descriptions.
osource "C:/zephyr_dev/workspace/zephyr/arch/rx/Kconfig"
osource "C:/zephyr_dev/workspace/zephyr/arch/x86/Kconfig"
osource "C:/zephyr_dev/workspace/zephyr/arch/xtensa/Kconfig"
osource "C:/zephyr_dev/workspace/zephyr/arch/sparc/Kconfig"
osource "C:/zephyr_dev/workspace/zephyr/arch/riscv/Kconfig"
osource "C:/zephyr_dev/workspace/zephyr/arch/posix/Kconfig"
osource "C:/zephyr_dev/workspace/zephyr/arch/mips/Kconfig"
osource "C:/zephyr_dev/workspace/zephyr/arch/arm64/Kconfig"
osource "C:/zephyr_dev/workspace/zephyr/arch/arm/Kconfig"
osource "C:/zephyr_dev/workspace/zephyr/arch/arc/Kconfig"
```

## ionode-test/build/Kconfig/boards/Kconfig
```kconfig
# Load Zephyr board Kconfig descriptions.
osource "C:/zephyr_apps/boards/ammortal/ionode_a2/Kconfig"
config BOARD_REVISION_A
	def_bool y
```

## ionode-test/build/Kconfig/boards/Kconfig.defconfig.tmp
```kconfig
# Load Zephyr board defconfig descriptions.
osource "C:/zephyr_apps/boards/ammortal/ionode_a2/Kconfig.defconfig"
```

## ionode-test/build/Kconfig/boards/Kconfig.ionode_a2
```kconfig
# Load board Kconfig descriptions.
osource "C:/zephyr_apps/boards/ammortal/ionode_a2/Kconfig.ionode_a2"
```

## ionode-test/build/Kconfig/boards/Kconfig.tmp
```kconfig
# Load Zephyr board Kconfig descriptions.
osource "C:/zephyr_apps/boards/ammortal/ionode_a2/Kconfig"
```
